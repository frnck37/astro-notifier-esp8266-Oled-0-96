#include <Wire.h>
#include <Adafruit_GFX.h>
#include <Adafruit_SSD1306.h>
#include <time.h>
#include <NTPClient.h>
#include <WiFiUdp.h>
#include <ESP8266WiFi.h>
#include <ESP8266HTTPClient.h>
#include <ArduinoJson.h>
#include <WiFiManager.h> // https://github.com/tzapu/WiFiManager
#define FS_NO_GLOBALS
#include <FS.h>

#include <Fonts/FreeMono9pt7b.h>
#include <Fonts/FreeSerif12pt7b.h>
#include <Fonts/FreeSerifBold9pt7b.h>
#include <Fonts/FreeSerifItalic9pt7b.h>
#include <Fonts/FreeMonoBold12pt7b.h>

#define SCREEN_WIDTH 128
#define SCREEN_HEIGHT 64

WiFiClient client;

HTTPClient http;    //Declare object of class HTTPClient

// 'cosmo', 128x64px
const unsigned char epd_bitmap_cosmo [1024] PROGMEM = {
  0x00, 0x07, 0x80, 0x20, 0x00, 0x00, 0x00, 0x07, 0xff, 0xf8, 0x00, 0x00, 0x00, 0x00, 0x00, 0x00,
  0x00, 0xff, 0xfe, 0x70, 0x00, 0x00, 0x00, 0xff, 0xff, 0xff, 0xc0, 0x00, 0x00, 0x00, 0x00, 0x00,
  0x01, 0xff, 0xfe, 0x70, 0x00, 0x00, 0x07, 0xff, 0xff, 0xff, 0xf8, 0x00, 0x00, 0x00, 0x00, 0x00,
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  0x00, 0x00, 0x00, 0x00, 0x01, 0xff, 0xff, 0xff, 0xff, 0xff, 0xff, 0xff, 0xfe, 0x3f, 0xff, 0xc7
};

// Array of all bitmaps for convenience. (Total bytes used to store images in PROGMEM = 1040)
const int epd_bitmap_allArray_LEN = 1;
const unsigned char* epd_bitmap_allArray[1] = {epd_bitmap_cosmo};


#define OLED_RESET     -1 // Reset pin # (or -1 if sharing Arduino reset pin)
#define SCREEN_ADDRESS 0x3D ///< See datasheet for Address; 0x3D for 128x64, 0x3C for 128x32
Adafruit_SSD1306 display(SCREEN_WIDTH, SCREEN_HEIGHT, &Wire, OLED_RESET);



float p = 3.1415926;

// Variables de travail
unsigned long epoch = 0;
int nujour = 0; //numero jour de la semaine avec 0 pour dimanche
String jour = "mon jour"; // dimanche, lundi, etc.
String heure = "mon heure ..";
char buffer[80]; // Stockage de la date complete

//Creation objet WIFI UDP puis du client NTP
WiFiUDP ntpUDP;
//Creation objet client NTP avec les parametres suivants :
// - pool de serveurs NTP
// - en option le décalage horaire en secondes, ici 3600 pour GMT+1, pour GMT+8 mettre 28800, etc.
// - en option l intervalle de mise à jour en millisecondes par défaut à 60 secondes
NTPClient timeClient(ntpUDP, "europe.pool.ntp.org", 3600, 60000);


void setup() {
  uint16_t time = millis();

  time = millis() - time;
  // Demarrage client NTP
  timeClient.begin();

  display.begin();
  display.display();

  WiFi.mode(WIFI_STA); // explicitly set mode, esp defaults to STA+AP
  // it is a good practice to make sure your code sets wifi mode how you want it.


  //WiFiManager, Local intialization. Once its business is done, there is no need to keep it around
  WiFiManager wm;

  // reset settings - wipe stored credentials for testing
  // these are stored by the esp library
  //wm.resetSettings();

  // Automatically connect using saved credentials,
  // if connection fails, it starts an access point with the specified name ( "AutoConnectAP"),
  // if empty will auto generate SSID, if password is blank it will be anonymous AP (wm.autoConnect())
  // then goes into a blocking loop awaiting configuration and will return success result

  bool res;
  // res = wm.autoConnect(); // auto generated AP name from chipid
  res = wm.autoConnect("SPACE CONNECTION"); // anonymous ap
  //res = wm.autoConnect("AutoConnectAP","password"); // password protected ap

  if (!res) {
    display.clearDisplay();
    display.setFont(&FreeMono9pt7b);
    display.setTextColor(WHITE);
    display.setCursor(0, 20);
    display.println("connect to wifi");
    display.setCursor(0, 50);            // Start at top-left corner
    display.println(F("SPACE CONNECTION"));
    display.display();
    delay(3000);

  }
  else {
    //if you get here you have connected to the WiFi

    display.clearDisplay();
    display.setFont(&FreeMono9pt7b);
    display.setTextColor(WHITE);
    display.setCursor(10, 20);            // Start at top-left corner
    display.println(F("CONNEXION OK!"));
    display.display();
    delay(1000);

  }

  Serial.begin(115200);
  display.begin(SSD1306_SWITCHCAPVCC, 0x3C);
  display.setFont(&FreeMono9pt7b);
  display.clearDisplay();
  display.display();
  display.clearDisplay();
  // Draw the bitmap:
  // drawBitmap(x position, y position, bitmap data, bitmap width, bitmap height, color)
  display.drawBitmap(0, 0, epd_bitmap_cosmo, 128, 64, WHITE);
  delay(1500);
  display.display();

}
void loop() {
  // Recup heure puis affichage
  timeClient.update();
  epoch = timeClient.getEpochTime(); // Heure Unix
  nujour = timeClient.getDay();    // jour de la semaine
  heure = timeClient.getFormattedTime(); // heure
  // Calcul de la date en convertissant le temps UNIX epoch
  time_t timestamp = epoch;
  struct tm * pTime = localtime( & timestamp );
  strftime( buffer, 80, "%d/%m/%Y", pTime );
  //Serial.println(buffer);

  switch (nujour) { // on determine le jour
    case 0:
      jour = "dimanche";
      break;
    case 1:
      jour = "lundi";
      break;
    case 2:
      jour = "mardi";
      break;
    case 3:
      jour = "mercredi";
      break;
    case 4:
      jour = "jeudi";
      break;
    case 5:
      jour = "vendredi";
      break;
    case 6:
      jour = "samedi";
      break;
  }

  display.clearDisplay();
  display.setFont(&FreeMono9pt7b);
  display.setTextColor(WHITE);
  display.setCursor(35, 10);
  display.println(jour);
  display.setCursor(10, 35);
  display.println(buffer);
  display.setFont(&FreeSerifBold9pt7b);
  display.setCursor(35, 55);
  display.println(heure);
  delay(3000);
  display.display();

  display.clearDisplay();
  // Draw the bitmap:
  // drawBitmap(x position, y position, bitmap data, bitmap width, bitmap height, color)
  display.drawBitmap(0, 0, epd_bitmap_cosmo, 128, 64, WHITE);
  delay(3000);
  display.display();


  HTTPClient http;    //Declare object of class HTTPClient


  http.begin(client, "http://api.open-notify.org/astros.json");    //Specify request destination

  int httpCode = http.GET();            //Send the request
  String payload = http.getString();    //Get the response payload from server

  if (httpCode == 200)
  {
    // Allocate JsonBuffer
    // Use arduinojson.org/assistant to compute the capacity.
    //const size_t capacity = JSON_OBJECT_SIZE(3) + JSON_ARRAY_SIZE(2) + 1024;
    // Stream& input;

    StaticJsonDocument<1024> doc;

    DeserializationError error = deserializeJson(doc, payload);

    if (error) {
      display.clearDisplay();
      display.setFont(&FreeSerifBold9pt7b);
      display.setTextColor(WHITE);
      display.setCursor(10, 20);
      display.println(F("deserializeJson() failed: "));
      display.setCursor(10, 40);
      display.println(error.f_str());
      return;
    }

    int number = doc["number"];

    display.clearDisplay();
    display.setFont(&FreeSerifItalic9pt7b);
    display.setTextColor(WHITE);
    display.setCursor(0, 15);
    display.println("ASTRONAUTES");
    display.setCursor(15, 30);
    display.println("dans l'espace");
    display.setFont(&FreeMonoBold12pt7b);
    display.setCursor(55, 59);
    display.println(number);
    delay(2000);
    display.display();


    for (JsonObject people_item : doc["people"].as<JsonArray>()) {

      const char* people_item_craft = people_item["craft"]; // "Shenzhou 13", "Shenzhou 13", "Shenzhou 13", ...
      const char* people_item_name = people_item["name"]; // "Zhai Zhigang", "Wang Yaping", "Ye Guangfu", ...

      for ( int j = 0; j < number; ++j ) // output each array element's value

        display.clearDisplay();
        display.setFont(&FreeSerifItalic9pt7b);
        display.setTextColor(WHITE);
        display.setCursor(2, 13);
        display.println(people_item_craft);
        display.setTextColor(WHITE);
        display.setFont(&FreeSerifBold9pt7b);
        display.setCursor(1, 39);
        display.println(people_item_name);
        delay(2200);
        display.display();

      }
    
  }
  http.end();  //Close connection


  http.begin(client, "http://api.open-notify.org/iss-now.json");    //Specify request destination

  int httpCodeb = http.GET();            //Send the request
  String payloadb = http.getString();    //Get the response payload from server


  if (httpCodeb == 200)
  {
    // Allocate JsonBuffer
    // Use arduinojson.org/assistant to compute the capacity.
    const size_t capacity = JSON_OBJECT_SIZE(2) + JSON_OBJECT_SIZE(3) + 192;
    // Stream& input;

    // Stream& input;

    StaticJsonDocument<192> docb;

    DeserializationError error = deserializeJson(docb, payloadb);

    if (error) {
      display.clearDisplay();
      display.setFont(&FreeSerifBold9pt7b);
      display.setTextColor(WHITE);
      display.setCursor(10, 20);
      display.println(F("deserializeJson() failed: "));
      display.setCursor(10, 40);
      display.println(error.f_str());
      return;
    }

    long timestamp = docb["timestamp"]; // 1649869660
    const char* messageb = docb["message"]; // "success"

    const char* iss_position_longitude = docb["iss_position"]["longitude"]; // "-121.8565"
    const char* iss_position_latitude = docb["iss_position"]["latitude"]; // "39.6452"

    display.clearDisplay();
    display.setFont(&FreeSerifItalic9pt7b);
    display.setTextColor(WHITE);
    display.setCursor(25, 11);
    display.println("ISS POS°");
    display.setFont();
    display.setCursor(0, 18);
    display.println("long:");
    display.drawRoundRect(25, 18, 90, 20, 2, WHITE);
    display.setCursor(35, 25);
    display.println(iss_position_longitude);
    display.setCursor(0, 42);
    display.println("lat:");
    display.drawRoundRect(25, 42, 90, 20, 2, WHITE);
    display.setCursor(37, 45);
    display.println(iss_position_latitude);
    delay(3500);
    display.display();
  }
  else
  {
    display.println("Error in response ISS");
    delay(1500);
    display.display();
    }
  http.end();  //Close connection

}
